qcom,2887645_tcl_krypton_3860mah_averaged_masterslave_apr5th2017 {
			qcom,max-voltage-uv = <0x432380>;
			qcom,nom-batt-capacity-mah = <0xf14>;
			qcom,batt-id-kohm = <0x12>;
			qcom,battery-beta = <0xd34>;
			qcom,thermal-coefficients = [da 86 f0 50 08 3c];
			qcom,fastchg-current-ma = <0xbb8>;
			qcom,battery-type = "BYD";
			qcom,fg-cc-cv-threshold-mv = <0x1126>;
			qcom,chg-rslow-comp-c1 = <0x553321>;
			qcom,chg-rslow-comp-c2 = <0xc723ec>;
			qcom,chg-rs-to-rslow = <0xfcd94>;
			qcom,chg-rslow-comp-thr = <0xc9>;
			qcom,checksum = <0x939c>;
			qcom,gui-version = "PMI8950GUI - 2.0.0.16";
			qcom,fg-profile-data = <0xd783597c 0x7c80a375 0x5083485a 0xbe809e8c 0x32820599 0x3cb7fdc2 0x58171388 0xa67e1182 0x437c4683 0xca72577c 0xab687182 0x329836b6 0x34c25e11 0x8f0ff859 0x147071fd 0x653ee045 0xc2430000 0x6147982a 0xfe3a0000 0x00 0x00 0x2e6a4469 0x4878258a 0xc96fed68 0x2172b983 0x656dc863 0xa38545b2 0x1b406817 0x66a0710c 0x2800ff36 0xf0113003 0x0c>;
		};
